## conf/layer.conf
```bitbake
# Mixtile custom Yocto layer
BBPATH .= ":${LAYERDIR}"

BBFILES += "${LAYERDIR}/recipes-*/*/*.bb ${LAYERDIR}/recipes-*/*/*.bbappend"

BBFILE_COLLECTIONS += "mixtile"
BBFILE_PATTERN_mixtile = "^${LAYERDIR}/"
BBFILE_PRIORITY_mixtile = "9"

LAYERSERIES_COMPAT_mixtile = "scarthgap"
```

## conf/machine/mixtile-core3588e.conf
```bitbake
# Mixtile Core3588E machine configuration

#@TYPE: Machine
#@NAME: Mixtile Core3588E

require conf/machine/include/rk3588.inc

# Core3588E board-specific kernel and bootloader settings.
KERNEL_DEVICETREE = "rockchip/rk3588-mixtile-core3588e.dtb"
KBUILD_DEFCONFIG = "mixtile_core3588e_defconfig"
UBOOT_MACHINE = "mixtile_core3588e_defconfig"


PREFERRED_PROVIDER_virtual/kernel = "linux-rockchip"
PREFERRED_PROVIDER_u-boot = "u-boot-rockchip"
```
